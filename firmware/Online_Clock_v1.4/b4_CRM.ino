//********** ФУНКЦИИ CRM **********//


//Пустая функция обработки виртуальных и аппаратных кнопок (должна быть хотя бы пустой обязательно)
void btnResponce(const char* name) {
}



//Функция - планировщик (цикличное выполнение через указанный интервал, настраивается в "SetupCRM()")
void myLoopRun() {
  TEMP();                         // Функция опроса датчика температуры
  valPR = analogRead(ANALOG_PR);  // Считываем сырые значения в глобальную переменную

  val_Update_NTP = ntp.getFullFormLastUpdate();             // Получаем дату и время последней успешной синхронизации (всегда возвращает дату и время последней синхронизации)
  crm.webUpdate("NTP_val_Update", String(val_Update_NTP));  // Просто обновляем значение без перезагрузки страницы

  crm.webUpdate("illum_PR", String(valPR));  // Обновляем значение с датчика освещённости без перезагрузки страницы
}



//Метод "update()" вызывается при каждом изменении значения элементов через веб интерфейс
void update() {

  //Блок для смены значения флага Вкл./Выкл. звука ошибки при чтении датчика температуры "DS18B20"
  bool _Flag_Err = Flag_Err;                 // Создаём логическую переменную и считываем в неё состояние с "Flag_Err"
  Flag_Err = crm.var("Dallas_Sign") == "1";  // Получаем значение переменной из конфига "crm.var("ID")" считав состояние ("1" - это true (условие проверки), так проще написать, потому, что WEB интерфейс возвращает String)
  if (_Flag_Err != Flag_Err) {               // Если логические переменные неравны, то...
    crm.var(("Dallas_Sign"), Flag_Err);      // Записываем значение переменной в конфиг "crm.var("ID", "Значение")"

    // Отправляем уведомление на WEB интерфейс о состоянии подачи ежечасного звукового сигнала
    // crm.webNotif("[Цвет]", "[Сообщение]", [время показа, с], [крестик закрыть (1, true)]);
    // Цвет: green, red, orange, blue, "" - без цвета
    crm.webNotif(Flag_Err ? "green" : "Orange", Flag_Err ? "Звук при ошибки DS18B20 Вкл. ✔" : "Звук при ошибки DS18B20 Выкл. X", SHOW_NOTIFIC, CROSS_CLOSE);
  }


  //Блок для смены значения флага Вкл./Выкл. подачи ежечасного звукового сигнала
  bool _Flag_Sig = Flag_Sig;               // Создаём логическую переменную и считываем в неё состояние с "Flag_Sig"
  Flag_Sig = crm.var("Hour_Sign") == "1";  // Получаем значение переменной из конфига "crm.var("ID")" считав состояние ("1" - это true (условие проверки), так проще написать, потому, что WEB интерфейс возвращает String)
  if (_Flag_Sig != Flag_Sig) {             // Если логические переменные неравны, то...
    crm.var(("Hour_Sign"), Flag_Sig);      // Записываем значение переменной в конфиг "crm.var("ID", "Значение")"

    // Отправляем уведомление на WEB интерфейс о состоянии подачи ежечасного звукового сигнала
    // crm.webNotif("[Цвет]", "[Сообщение]", [время показа, с], [крестик закрыть (1, true)]);
    // Цвет: green, red, orange, blue, "" - без цвета
    crm.webNotif(Flag_Sig ? "green" : "Orange", Flag_Sig ? "Ежечасный звуковой сигнал: Вкл. ✔" : "Ежечасный звуковой сигнал: Выкл. X", SHOW_NOTIFIC, CROSS_CLOSE);
  }


  //Блок для Вкл./Выкл. разных цветов на сегментах и точках
  bool _Flag_Each_Sigment = Flag_Each_Sigment;         // Создаём логическую переменную и считываем в неё состояние с "Flag_Each_Sigment"
  Flag_Each_Sigment = crm.var("Each_Sigment") == "1";  // Получаем значение переменной из конфига "crm.var("ID")" считав состояние ("1" - это true (условие проверки), так проще написать, потому, что WEB интерфейс возвращает String)
  if (_Flag_Each_Sigment != Flag_Each_Sigment) {       // Если логические переменные неравны, то...
    crm.var(("Each_Sigment"), Flag_Each_Sigment);      // Записываем значение переменной в конфиг "crm.var("ID", "Значение")"

    // Отправляем уведомление на WEB интерфейс о состоянии цветов на сегментах и точках
    // crm.webNotif("[Цвет]", "[Сообщение]", [время показа, с], [крестик закрыть (1, true)]);
    // Цвет: green, red, orange, blue, "" - без цвета
    crm.webNotif(Flag_Each_Sigment ? "green" : "Orange", Flag_Each_Sigment ? "Разноцветные сегменты Вкл. ✔" : "Разноцветные сегменты Выкл. X", SHOW_NOTIFIC, CROSS_CLOSE);
  }


  //Блок для смены значения флага переключения точек в конфиге
  bool _TimeDot = TimeDot;               // Создаём логическую переменную и считываем в неё состояние с "TimeDot"
  TimeDot = crm.var("Time_Dot") == "1";  // Получаем значение переменной из конфига "crm.var("ID")" считав состояние ("1" - это true (условие проверки), так проще написать, потому, что WEB интерфейс возвращает String)
  if (_TimeDot != TimeDot) {             // Если логические переменные неравны, то...
    crm.var(("Time_Dot"), TimeDot);      // Записываем значение переменной в конфиг "crm.var("ID", "Значение")"

    // Отправляем уведомление на WEB интерфейс о смене времени отображения точек на часах
    // crm.webNotif("[Цвет]", "[Сообщение]", [время показа, с], [крестик закрыть (1, true)]);
    // Цвет: green, red, orange, blue, "" - без цвета
    crm.webNotif(TimeDot ? "green" : "Orange", TimeDot ? "Раз в 1 секунду ✔" : "Раз в 0.5 сек ✔", SHOW_NOTIFIC, CROSS_CLOSE);
  }


  //Блок для смены значения флага Вкл./Выкл. эффекта смены минут
  bool _Flag_EfSw = Flag_EfSw;                // Создаём логическую переменную и считываем в неё состояние с "Flag_EfSw"
  Flag_EfSw = crm.var("Sw_Clock_Ef") == "1";  // Получаем значение переменной из конфига "crm.var("ID")" считав состояние ("1" - это true (условие проверки), так проще написать, потому, что WEB интерфейс возвращает String)
  if (_Flag_EfSw != Flag_EfSw) {              // Если логические переменные неравны, то...
    crm.var(("Sw_Clock_Ef"), Flag_EfSw);      // Записываем значение переменной в конфиг "crm.var("ID", "Значение")"

    // Отправляем уведомление на WEB интерфейс о состоянии эффекта смены минут
    // crm.webNotif("[Цвет]", "[Сообщение]", [время показа, с], [крестик закрыть (1, true)]);
    // Цвет: green, red, orange, blue, "" - без цвета
    crm.webNotif(Flag_EfSw ? "green" : "Orange", Flag_EfSw ? "Эффект смены минут Вкл. ✔" : "Эффект смены минут Выкл. X", SHOW_NOTIFIC, CROSS_CLOSE);
  }
}



//Функция перезагрузки через WEB интерфейс (с сохранением конфига перед перезагрузкой)
void Reboot() {
  // crm.webNotif("[Цвет]", "[Сообщение]", [время показа, с], [крестик закрыть (1, true)]);
  // Цвет: green, red, orange, blue, "" - без цвета
  crm.webNotif("red", "Перезагрузка часов", SHOW_NOTIFIC, CROSS_CLOSE);
  crm.espReboot();  // Отправляет модуль на перезагрузку, с сохранением настроек, если требуется.
}



//Функция сброса настроек при нажатии физической кнопки "Reset" на часах
void ResButt() {
  buzRes();           // Подаём звук нажатия кнопки
  Ef_Before_Reset();  // Запускаем эффект на часах перед сбросом
  crm.cfgDelete();    // Форматируем FS через встроенную функцию в "CRMui" (после форматирования ESP8266 перезагрузится и войдёт в режим AP)
  delay(200);         // Для корректного стирания FS (не задействуется, тем не менее для перестраховки)
}


//Функция для разовой настройки фреймворка после включения ESP8266
void SetupCRM() {
  // callBackButtonEvent. Обработка виртуальных и аппаратных кнопок по событию
  // crm.btnCallback([Event function]);
  crm.btnCallback(btnResponce);

  // Инициализация библиотеки, памяти и прочих функций
  // Параметры со * обязательны.
  // crm.begin("[*Название проекта]", [*Ф-я интерфейса], [Ф-я обновления переменных], [Ф-я API], [Скорость серийного порта, доп. отладка]);
  //crm.begin(PROJECT, interface, NULL, NULL, 115200);
  //crm.begin(PROJECT, interface, update, api, 115200);
  crm.begin(PROJECT, interface, update);


  // Авторизация в веб интерфейсе (настройка применится только после перезагрузки)
  WebAuthorization = crm.var("WebAuth") == "1";  // Если при включении ESP8266 в конфиге сохранён "1", то поднимаем флаг "WebAuthorization", иначе оставляем опущенным
  if (WebAuthorization == true) {                // Если флаг поднят, то включаем авторизацию по Логину/Паролю на WEB интерфейсе

    //Получаем значение из конфига json через WebFramework "CRMui"
    //crm.var(["ID переменной"])
    String W_Login = crm.var("Web_Login");      // Получаем Логин с WEB интерфейса
    String W_Password = crm.var("Web_Passwd");  // Получаем Пароль с WEB интерфейса

    //Присваиваем считанные значения для авторизации в соответствующие поля
    //crm.setWebAuth("[*Имя пользователя]", "[Пароль]"); // Параметры со * обязательны.
    crm.setWebAuth(W_Login, W_Password);
  }


  // Планировщик
  // NAME.once_ms(time_ms, FunctionName); - Выполнить единожды через указанный интервал
  // NAME.attach_ms(time_ms, FunctionName); - Цикличное выполнение через указанный интервал
  // NAME.detach(); - Деактивировать
  myLoop.attach_ms(2000, myLoopRun);  // Опрос каждые 2 секунды

  // Конвертирование uint64_t в String
  // crm.uint64ToStr(uint64_t);

  // Контакты
  // Позволяет задать свои контактные данные для связи в левом нижнем углу WEB интерфейса.
  // crm.contacts([Электронная почта], [Телеграм], [Домашняя страница]);
  if (CONTACTS == 1) crm.contacts(CONTACTS_MAIL, CONTACTS_TELEGA, CONTACTS_WEBSITE);  //  Если (CONTACTS равен 1), то инфа НЕ выводится

  // Версия прошивки проекта, если не используется, то отображается версия "CRMui"
  // crm.version ("[Любая строка]");
  crm.version(VERSION);
}




// Метод, вызывается при открытии веб интерфейса (тут формируется и выводится весь WEB интерфейс).
void interface() {
  //Страница "Главная"
  crm.page("&#xe802; Главная");  // Значок и заголовок страницы

  //Разделитель
  //crm.output({[Тип], ["Размер в px"], ["Отступы, смотри свойство: margin html"]});
  crm.output({ OUTPUT_HR, "1px", "20px 10% -31px" });

  //Выводим краткую информацию в виде таблицы
  // Вывод значений в виде таблицы
  // crm.output({[Тип], ["ID"], ["Заголовок"], ["Значение при загрузке страницы"], ["цвет в HEX формате"]});
  crm.output({ OUTPUT_TABL, "NTP_val_Time", "Время:", val_Time_NTP, "#08ff00" });                             // Выводим время
  crm.output({ OUTPUT_TABL, "NTP_val_Date", "Дата:", val_Date_NTP, "#ff0" });                                 // Выводим дату
  crm.output({ OUTPUT_TABL, "NTP_val_Update", "Последняя синхронизация была:", val_Update_NTP, "#f72727" });  // Выводим дату
  crm.output({ OUTPUT_TABL, "TempC", "Температура:", str_tempC, "f0f" });                                     // Выводим тепературу с "°C"
  crm.output({ OUTPUT_HR, "1px", "-3px 10% 0" });                                                             //Разделитель


  //Поля ввода для коректировки температуры
  // crm.input({[Тип], ["ID"], ["Заголовок / значок"], ["Значение по умолчанию"], ["паттерн, смотри в инете"]});
  crm.input({ INPUT_TEXT, "CorrectTemp", "&#xf2c8; Коэффициент корректировки температуры (чем больше число, тем ниже температура)", CORRECT_TEMP });  // Поле ввода значений


  // Дуговые индикаторы
  // Тип: GAUDE_1 - со стрелкой, GAUDE_2 - без стрелки
  // crm.gauge({[Тип], "[ID]", "[Заголовок]", [Min, шкала], [Max шкала], [Значение при загрузке], {[Цветовая палитра]}, ["Единицы измерения"], [Группировка]});
  //Температура
  crm.gauge({
    GAUDE_1, "Graph_TempC", "Температура", 0, 50, 0, {
                                                       { "#3FFBF6", "0", "16" },   // Указываются конкретные значения
                                                       { "#FFFF00", "17", "20" },  // Цвет, начало заны, конец зоны, в формате HEX
                                                       { "#00FF00", "21", "27" },  // Количество не больше 6
                                                       { "#FFFF00", "28", "34" },
                                                       { "#FF0000", "35", "50" },
                                                     },
    "°C",  // Единицы измерения
  });

  // Освещённость в RAW
  crm.gauge({
    GAUDE_2, "illum_PR", "Освещённость", 0, 1024, valPR, {
                                                           { "#00FF00", "0" },    // 0 raw
                                                           { "#FF0000", "1024" }  // 1024 raw
                                                         },
    "raw",  // Единицы измерения
    true    // Группировать с предыдущим, def = false (что бы индикаторы отображались в одну линию)
  });



  /* -------------------------------------------------------------------- */
  /* -------------------------------------------------------------------- */



  //Страница "NTP"
  crm.page("&#xe80b; NTP");  // Значок и заголовок страницы

  //Поля ввода данных для NTP
  // crm.input({[Тип], ["ID"], ["Заголовок / значок"], ["Значение по умолчанию"], ["паттерн, смотри в инете"]});
  crm.input({ INPUT_TEXT, "NTP_Pool", "&#xe81f; Сервер NTP", SET_HOST });                                     // Поле ввода NTP хоста
  crm.input({ INPUT_TEXT, "NTP_GTM", "&#xf0e4; Часовой пояс в GMT", SET_GMT, "[0-9\s-]{1,3}" });              // Поле ввода часового пояса "в GMT часах"
  crm.input({ INPUT_TEXT, "NTP_Period", "&#xe82b; Период обновления в минутах", SET_PERIOD, "[0-9]{1,4}" });  // Поле ввода периода обновления "в минутах". Корректный ввод только чисел по регулярному выражению от 1 до 4-х символов

  //Выводим дату время на WEB интерфейс
  //crm.output({[Тип], ["ID"], "["Заголовок"]", ["Текст"], ["цвет в HEX формате"]});
  crm.output({ OUTPUT_TEXT, "NTP_val_Time", "Время: ", val_Time_NTP, "#08ff00" });  // Отобразить время на странице
  crm.output({ OUTPUT_TEXT, "NTP_val_Date", "Дата: ", val_Date_NTP, "#ff0" });      // Отобразить дату на странице

  //Разделитель
  //crm.output({[Тип], ["Размер в px"], ["Отступы, смотри свойство: margin html"]});
  crm.output({ OUTPUT_HR, "3px", "30px 1% -10px" });

  //Кнопка принудительной синхронизации
  //crm.input({[Тип], ["Вызов Функции"], ["Текст описания кнопки"]});
  crm.input({ INPUT_BUTTON, "ForceUpdNTP", "Синхронизировать с NTP" });


  //Кнопка перезагрузки (настройки применятся только после перезагрузки)
  //crm.input({[Тип], ["Вызов Функции"], ["Текст описания кнопки"]});
  crm.input({ INPUT_BUTTON, "reboot", "Применить с перезагрузкой" });



  /* -------------------------------------------------------------------- */
  /* -------------------------------------------------------------------- */



  //Страница "Часы"
  crm.page("&#xe80b; Часы");  // Значок и заголовок страницы

  // Поле выбора (селект). Создаём выпадающий список с выбором цвета на часах
  // crm.selOpt("{[Заголовок опции]", "[Значение]}");
  // crm.select({["ID"], ["Заголовок / значок"], ["Значение по умолчанию"], "[Флаг обновления интерфейса 1 - да, 0 - нет]" });
  crm.selOpt({ "Палитра цветов", "1" });
  crm.selOpt({ "Рандомные цвета", "2" });
  crm.select({ "select_Color", "Выбор режима отображения цветов", "2", "1" });  // По умолчанию выбираем Палитрy цветов

  Regim_Color = crm.var("select_Color").toInt();  // Так как у нас всего 2 цифры (селекта), то смело присваиваем байтовой переменной целое число


  //Режим 1 (Палитра цветов)
  // Получить значение из конфига: crm.var(["ID переменной"]). Преобразуем в int и сверяем
  if (Regim_Color == 1) {  // Если выбран режим палитры цветов

    // Описание Палитры цветов. Используем маркос "F()", что бы НЕ хранить текст в ОЗУ. Использование значков: &#[код];
    String txt_ColorOne = F("Позволяет задать любой произвольный цвет и оттенок на часах");

    //Описание на WEB интерфейсе, что выбран режим Палитры цветов
    //crm.output({[Тип], ["ID"], "["Заголовок"]", ["Текст"], ["цвет в HEX формате"]});
    crm.output({ OUTPUT_TEXT, "Text_Color", "Выбран режим Палитры цветов", txt_ColorOne, "#f7f714" });

    // Поле выбора цвета для LED
    // crm.input({[Тип], ["ID"], ["Заголовок"], ["цвет в HEX формате"] });
    crm.input({ INPUT_COLOR, "YourColor", "Установить цвет:", "#FF0000" });
  }


  //Режим 2 (Рандомные цвета)
  // Получить значение из конфига: crm.var(["ID переменной"]). Преобразуем в int и сверяем
  if (Regim_Color == 2) {  // Если выбраны рандомные цвета

    // Описание рандомного набора цветов. Используем маркос "F()", что бы НЕ хранить текст в ОЗУ. Использование значков: &#[код];
    String txt_ColorThree = F("В режиме рандомных цветов всего одна кнопка. <br> При нажатии которой генерируется рандомный цвет и выводится на часы.");

    // Описание на WEB интерфейсе, что выбран рандомный набор цвета
    //crm.output({[Тип], ["ID"], "["Заголовок"]", ["Текст"], ["цвет в HEX формате"]});
    crm.output({ OUTPUT_TEXT, "Text_Color", "Выбраны рандомные цвета", txt_ColorThree, "#4fd503" });

    // Кнопка генеатора рандомного цвета (кнопка состоящая только из значка с настройкой размера и отступов)
    // crm.input({[Тип], ["ID"], ["Заголовок / значок"], ["Внутренние отступы, смотри: padding html"], ["r - вряд"], ["Размер"]});
    crm.input({ INPUT_BUTTON, "RndBtn", "&#xe82c;", "13px 11px 10px 20px", "r", "65" });
  }



  //Разделитель
  //crm.output({[Тип], ["Размер в px"], ["Отступы, смотри свойство: margin html"]});
  crm.output({ OUTPUT_HR, "3px", "30px 1% -10px" });


  // Переключатель Вкл./Выкл. разных цветов на сегментах и точках
  // crm.card({[Тип], ["ID"], ["Заголовок"], ["Значение по умолчанию"], ["Значок"], ["цвет в HEX формате"], [Новая группа]});
  // Значок указывается из списка icon.pdf, в формате [&#[CODE]];  без 0
  // Состояние автоматический не сохраняется в память
  crm.card({ CARD_CHECKBOX, "Each_Sigment", "Разноцветные сегменты: Выкл. / Вкл.", "0", "&#xe835;", "dots" });


  // Переключатель отображения точек на часах
  // crm.card({[Тип], ["ID"], ["Заголовок"], ["Значение по умолчанию"], ["Значок"], ["цвет в HEX формате"], [Новая группа]});
  // Значок указывается из списка icon.pdf, в формате [&#[CODE]];  без 0
  // Состояние автоматический не сохраняется в память
  crm.card({ CARD_CHECKBOX, "Time_Dot", "Точки на часах: 0,5 сек / 1 сек", "0", "&#xf204;", "dots" });


  //Разделитель
  //crm.output({[Тип], ["Размер в px"], ["Отступы, смотри свойство: margin html"]});
  crm.output({ OUTPUT_HR, "3px", "30px 1% -10px" });


  // Переключатель Вкл./Выкл. ежечасного сигнала
  // crm.card({[Тип], ["ID"], ["Заголовок"], ["Значение по умолчанию"], ["Значок"], ["цвет в HEX формате"], [Новая группа]});
  // Значок указывается из списка icon.pdf, в формате [&#[CODE]];  без 0
  // Состояние автоматический не сохраняется в память
  crm.card({ CARD_CHECKBOX, "Hour_Sign", "Ежечасный звуковой сигнал: Выкл. / Вкл.", "0", "&#xe821;", "sign" });


  // Переключатель Вкл./Выкл. звука ошибки при чтении датчика температуры "DS18B20"
  // crm.card({[Тип], ["ID"], ["Заголовок"], ["Значение по умолчанию"], ["Значок"], ["цвет в HEX формате"], [Новая группа]});
  // Значок указывается из списка icon.pdf, в формате [&#[CODE]];  без 0
  // Состояние автоматический не сохраняется в память
  crm.card({ CARD_CHECKBOX, "Dallas_Sign", "Звук при ошибки DS18B20: Выкл. / Вкл.", "0", "&#xf188;", "sign" });


  //Разделитель
  //crm.output({[Тип], ["Размер в px"], ["Отступы, смотри свойство: margin html"]});
  crm.output({ OUTPUT_HR, "3px", "30px 1% -10px" });


  // Переключатель Вкл./Выкл. эффекта смены минут
  // crm.card({[Тип], ["ID"], ["Заголовок"], ["Значение по умолчанию"], ["Значок"], ["цвет в HEX формате"], [Новая группа]});
  // Значок указывается из списка icon.pdf, в формате [&#[CODE]];  без 0
  // Состояние автоматический не сохраняется в память
  crm.card({ CARD_CHECKBOX, "Sw_Clock_Ef", "Эффект смены минут: Выкл. / Вкл.", "1", "&#xf2c5;", "EfClock" });



  /* -------------------------------------------------------------------- */
  /* -------------------------------------------------------------------- */



  //Страница "Яркость часов"
  crm.page("&#xf0eb; Яркость Часов");  // Значок и заголовок страницы

  // Поле выбора (селект). Создаём выпадающий список с выбором режима регулировки яркости
  // crm.selOpt("{[Заголовок опции]", "[Значение]}");
  // crm.select({["ID"], ["Заголовок / значок"], ["Значение по умолчанию"], "[Флаг обновления интерфейса 1 - да, 0 - нет]" });
  crm.selOpt({ "Авторегулировка", "1" });
  crm.selOpt({ "Ручная настройка", "2" });
  crm.selOpt({ "По расписанию", "3" });
  crm.select({ "select_Regim", "Выбор управления режимом яркости", "1", "1" });  // По умолчанию выбираем Авторегулировку

  Regim_bright = crm.var("select_Regim").toInt();  // Так как у нас всего 3 цифры, то смело присваиваем байтовой переменной целое число

  //Режим 1
  // Получить значение из конфига: crm.var(["ID переменной"]). Преобразуем в int и сверяем
  if (Regim_bright == 1) {  // Если выбран первый режим, включаем авторегулировки яркости

    // Описание пунктов Авторегулировки яркости. Используем маркос "F()", что бы НЕ хранить текст в ОЗУ. Использование значков: &#[код];
    String txt_One = F("Время опроса фоторезистора - чем БОЛЬШЕ время, тем медленнее меняется яркость. <br> Константа усиления - чем МЕНЬШЕ константа, тем РЕЗЧЕ будет прибавляться яркость. <br> Коэфициент фильтра - чем БОЛЬШЕ, тем медленнее меняется яркость. <br> Макс. и Мин. яркость - устанавливают Макс. и Мин. яркость свечения LED.");

    // Описание на WEB интерфейсе, что выбран режим Авторегулировки яркости
    //crm.output({[Тип], ["ID"], "["Заголовок"]", ["Текст"], ["цвет в HEX формате"]});
    crm.output({ OUTPUT_TEXT, "modes", "Выбран режим Авторегулировки яркости", txt_One, "#f7f714" });

    //Поля ввода для настройки Авторегулировки яркости
    // crm.input({[Тип], ["ID"], ["Заголовок / значок"], ["Значение по умолчанию"], ["паттерн, смотри в инете"]});
    crm.input({ INPUT_TEXT, "PR_Update", "&#xf201; Время опроса фоторезистора в (мс.)", TIME_UPDATE_PR, "[0-9]{1,4}" });  // Время опроса фоторезистора (в мс) и расчёта автояркости яркости (чем больше время - тем медленнее меняется яркость). Корректный ввод только чисел по регулярному выражению от 1 до 4-х символов
    crm.input({ INPUT_TEXT, "PR_Const", "&#xf1fe; Константа усиления (0 - 1023)", BRIGHT_CONSTANT, "[0-9]{1,4}" });       // Константа усиления от внешнего света (0 - 1023), чем МЕНЬШЕ константа, тем "резче" будет прибавляться яркость. Корректный ввод только чисел по регулярному выражению от 1 до 4-х символов
    crm.input({ INPUT_TEXT, "PR_Coef", "&#xf24e; Коэфициент фильтра (0.0 - 1.0)", COEF, "[0-9]{1}\.[0-9]{1}" });          // Коэффициент фильтра (0.0 - 1.0), чем больше - тем медленнее меняется яркость. Корректный ввод только чисел с точкой по регулярному выражению 3 символа [0.1]
    crm.input({ INPUT_TEXT, "PR_MaxBright", "&#xf185; Макс. яркость (0 - 254)", AUTO_MAX_BRIGHT, "[0-9]{1,3}" });         // Максимальная яркость (0 - 254). Корректный ввод только чисел по регулярному выражению от 1 до 4-х символов
    crm.input({ INPUT_TEXT, "PR_MinBright", "&#xf186; Мин. яркость (0 - 254)", AUTO_MIN_BRIGHT, "[0-9]{1,3}" });          // Минимальная яркость (0 - 254). Корректный ввод только чисел по регулярному выражению от 1 до 4-х символов
  }


  //Режим 2
  // Получить значение из конфига: crm.var(["ID переменной"]). Преобразуем в int и сверяем
  if (Regim_bright == 2) {  // Если выбран второй режим, включаем Ручную настройку яркости

    // Описание пунктов Ручной настройки. Используем маркос "F()", что бы НЕ хранить текст в ОЗУ. Использование значков: &#[код];
    String txt_Two = F("Просто задаём нужную яркость ползунком от 1% до 100%");

    // Описание на WEB интерфейсе, что выбран режим Ручной настройки яркости
    //crm.output({[Тип], ["ID"], "["Заголовок"]", ["Текст"], ["цвет в HEX формате"]});
    crm.output({ OUTPUT_TEXT, "modes", "Выбран режим ручной настройки яркости", txt_Two, "#f93689" });

    // Ползунок регулировки яркости
    // crm.range({["ID"], ["Заголовок"], ["Значение по умолчанию"], ["MIN"], ["MAX"], [Шаг], ["Единицы измерения"]});
    crm.range({ "manual_brigh", "Яркость", 15, PERC_MIN_BRIGHT, PERC_MAX_BRIGHT, 1, "%" });  // Ползунок с ручной регулировкой яркости от "PERC_MIN_BRIGHT"% до "PERC_MAX_BRIGHT"% с регулировкой шага в 1% (по умолчанию яркость на 15%)
  }


  //Режим 3
  // Получить значение из конфига: crm.var(["ID переменной"]). Преобразуем в int и сверяем
  if (Regim_bright == 3) {  // Если выбран третий режим, включаем режим регулировки яркости По расписанию

    // Описание пунктов настройки яркости по расписанию. Используем маркос "F()", что бы НЕ хранить текст в ОЗУ. Использование значков: &#[код];
    String txt_Three = F("Яркость НОЧНОГО режима в диапазоне (С чч:мм ДО чч:мм). <br> Яркость ДНЕВНОГО режима включается вне заданного диапазона. <br> Поддерживается инверсия начала и окончания ночного режима. <br> Яркость задаётся от 1% до 100%.");

    // Информируем на WEB интерфейсе, что выбран режим яркости по расписанию
    //crm.output({[Тип], ["ID"], "["Заголовок"]", ["Текст"], ["цвет в HEX формате"]});
    crm.output({ OUTPUT_TEXT, "modes", "Выбран режим По расписанию", txt_Three, "#4fd503" });

    //Поля ввода для настройки времени со скольки и до скольки задать ночной режм
    // crm.input({[Тип], ["ID"], ["Заголовок / значок"], ["Значение по умолчанию"]});
    crm.input({ INPUT_TIME, "Start_Night_Mode", "&#xe83b; Начало ночного режима", "19:30:00" });   // Если наступило данное время, меняем яркость на ночную. Корректный ввод только часов и минут по регулярному выражению
    crm.input({ INPUT_TIME, "End_Night_Mode", "&#xf0f4; Окончание ночного режима", "08:30:00" });  // Если прошло данное время, меняем яркость на дневную. Корректный ввод только часов и минут по регулярному выражению

    //Разделитель
    //crm.output({[Тип], ["Размер в px"], ["Отступы, смотри свойство: margin html"]});
    crm.output({ OUTPUT_HR, "3px", "30px 1% -10px" });

    // Ползунки регулировки яркости
    // crm.range({["ID"], ["Заголовок"], ["Значение по умолчанию"], ["MIN"], ["MAX"], [Шаг], ["Единицы измерения"]});
    crm.range({ "night_brigh", "Яркость ночного режима", 2, PERC_MIN_BRIGHT, PERC_MAX_BRIGHT, 1, "%" });  // Задаём яркость ползунком для ночного режима (по умолчанию яркость на 2%)
    crm.range({ "day_brigh", "Яркость дневного режима", 20, PERC_MIN_BRIGHT, PERC_MAX_BRIGHT, 1, "%" });  // Задаём яркость ползунком для дневного режима (по умолчанию яркость на 20%)
  }



  /* -------------------------------------------------------------------- */
  /* -------------------------------------------------------------------- */



  //Страница "Настройки"
  crm.page("&#xf1de; Настройки");  // Значок и заголовок страницы

  //Авторизация на WEB интерфейсе
  // Разделитель заголовок
  // crm.output({ [Тип], ["ID"], ["Заголовок"], ["Выравнивание"], ["#Цвет RGB"], ["Размер px"] }); Выравнивание: left, center, right;
  // Если не заменять заголовок через webUpdate, поле ID можно оставить пустым.
  crm.output({ OUTPUT_LABEL, "", "Управление WEB авторизацией", "left", "#0f0", "20" });

  //Вкл./Выкл. авторизацию на WEB интерфейсе по Логину/Паролю
  //Переключатель crm.input({[Тип], ["ID"], ["Заголовок"], ["Значение по умолчанию"], ["Обновление интерфейса: 1"] });
  crm.input({ INPUT_CHECKBOX, "WebAuth", "Выкл./Вкл. авторизацию", "0", "1" });

  //Проверка переключателя авторизации на WEB интерфейсе
  if (crm.var("WebAuth") == "1") {
    //Разделитель
    //crm.output({[Тип], ["Размер в px"], ["Отступы, смотри свойство: margin html"]});
    crm.output({ OUTPUT_HR, "3px", "30px 1% -10px" });

    //Поля ввода Логина и Пароля для WEB авторизации
    // crm.input({[Тип], ["ID"], ["Заголовок / значок"], ["Значение по умолчанию"], ["паттерн, смотри в инете"]});
    crm.input({ INPUT_TEXT, "Web_Login", "&#xf262; Введите Логин", WEB_LOGIN });       // Поле ввода Логина
    crm.input({ INPUT_TEXT, "Web_Passwd", "&#xe840; Введите Пароль", WEB_PASSWORD });  // Поле ввода пароля
  }

  //Разделитель
  //crm.output({[Тип], ["Размер в px"], ["Отступы, смотри свойство: margin html"]});
  crm.output({ OUTPUT_HR, "3px", "30px 1% -10px" });

  //MQTT
  // Разделитель заголовок
  // crm.output({ [Тип], ["ID"], ["Заголовок"], ["Выравнивание"], ["#Цвет RGB"], ["Размер px"] }); Выравнивание: left, center, right;
  // Если не заменять заголовок через webUpdate, поле ID можно оставить пустым.
  crm.output({ OUTPUT_LABEL, "", "Управление MQTT", "left", "#0f0", "20" });

  //Вкл./Выкл. авторизацию на WEB интерфейсе по Логину/Паролю
  //Переключатель crm.input({[Тип], ["ID"], ["Заголовок"], ["Значение по умолчанию"], ["Обновление интерфейса: 1"] });
  crm.input({ INPUT_CHECKBOX, "mqtt", "Выкл./Вкл. MQTT", "0", "1" });

  //Проверка переключателя авторизации на WEB интерфейсе
  if (crm.var("mqtt") == "1") {
    // Информируем на WEB интерфейсе, что это для тестовая форма
    //crm.output({[Тип], ["ID"], "["Заголовок"]", ["Текст"], ["цвет в HEX формате"]});
    crm.output({ OUTPUT_TEXT, "testMqtt", F("ЭТО ТЕСТОВЫЕ ФОРМЫ ВВОДА, ОНИ НИЧЕГО НЕ ДЕЛАЮТ В КОДЕ!"), F("Решил пока их оставить, сомневаясь добавлять или нет этот функционал..."), "#ff0000" });

    //Поля ввода Логина и Пароля для WEB авторизации
    // crm.input({[Тип], ["ID"], ["Заголовок / значок"], ["Значение по умолчанию"], ["паттерн, смотри в инете"]});
    crm.input({ INPUT_TEXT, "MQTT_Login", "&#xf262; Введите Логин MQTT", WEB_LOGIN });       // Поле ввода Логина MQTT
    crm.input({ INPUT_TEXT, "MQTT_Passwd", "&#xe840; Введите Пароль MQTT", WEB_PASSWORD });  // Поле ввода пароля MQTT
  }

  //Разделитель
  //crm.output({[Тип], ["Размер в px"], ["Отступы, смотри свойство: margin html"]});
  crm.output({ OUTPUT_HR, "3px", "30px 1% -10px" });

  //Кнопка перезагрузки (настройки применятся только после перезагрузки)
  //crm.input({[Тип], ["Вызов Функции"], ["Текст описания кнопки"]});
  crm.input({ INPUT_BUTTON, "reboot", "Применить с перезагрузкой" });



  /* -------------------------------------------------------------------- */
  /* -------------------------------------------------------------------- */



  //Страница "Wi-Fi"
  crm.page("<z class='zanim'>&#xe82b;</z> Wi-Fi");  // Класс HTML, значок и заголовок страницы
  // форма с полями для WiFi
  // crm.wifiForm([Режим работы], ["Название ТД"], ["Пароль ТД"], ["WiFi сеть для подключения", ["Пароль сети"], ["Время ожидания подключения"]]);
  // Режим работы: WIFI_AP - точка доступа, WIFI_STA - клиент, WIFI_AP_STA - ТД + Клиент
  crm.wifiForm(WIFI_AP, SSID_AP, PASSWD_AP);  // Настроен по умолчанию на точку доступа с паролем

  //Кнопка перезагрузки (настройки применятся только после перезагрузки)
  //crm.input({[Тип], ["Вызов Функции"], ["Текст описания кнопки"]});
  crm.input({ INPUT_BUTTON, "reboot", "Применить с перезагрузкой" });
}